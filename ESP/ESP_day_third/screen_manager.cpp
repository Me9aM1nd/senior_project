#include "screen_manager.h"
#include <SPI.h>
#include <Wire.h>
#include <Adafruit_GFX.h>
#include <Adafruit_SSD1306.h>
#include <ezButton.h>
#include "prot_uart.h"

#define SCREEN_WIDTH 128
#define SCREEN_HEIGHT 64

#define OLED_MOSI   23
#define OLED_CLK    18
#define OLED_DC     16
#define OLED_CS     5
#define OLED_RESET  17

void AllPixels();
void TextDisplay();
void drawTemperature();
void drawHeart();
void noFinger();
void drawPressure();

extern prot_uart_t* base_p;

Adafruit_SSD1306 display(SCREEN_WIDTH, SCREEN_HEIGHT, OLED_MOSI, OLED_CLK, OLED_DC, OLED_RESET, OLED_CS);
ezButton button_a(22);  // create ezButton object that attach to pin 7;
unsigned long lastCount;
unsigned long count;


// 'RPM', 128x64px
const unsigned char epd_bitmap_RPM [] PROGMEM = {
  0x00, 0x00, 0x00, 0x00, 0x00, 0x00, 0x00, 0x00, 0x00, 0x00, 0x00, 0x00, 0x00, 0x00, 0x00, 0x00, 
  0x00, 0x00, 0x00, 0x00, 0x00, 0x00, 0x00, 0x00, 0x00, 0x00, 0x00, 0x00, 0x00, 0x00, 0x00, 0x00, 
  0x00, 0x00, 0x00, 0x00, 0x00, 0x00, 0x00, 0x1f, 0xe0, 0x00, 0x00, 0x00, 0x00, 0x00, 0x00, 0x00, 
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  0x00, 0x00, 0x00, 0x1f, 0x00, 0x00, 0x00, 0x00, 0x00, 0x00, 0x03, 0xff, 0xff, 0xe0, 0x00, 0x00
};

// 'image_2023-09-26_210453374', 40x64px
const unsigned char temp_img [] PROGMEM = {
  0xff, 0xff, 0xff, 0xff, 0xff, 0xff, 0xff, 0xff, 0xff, 0xff, 0xff, 0xff, 0xff, 0xff, 0xff, 0xff, 
  0xff, 0xff, 0xff, 0xff, 0xff, 0xff, 0xff, 0xff, 0xff, 0xff, 0xff, 0xff, 0xff, 0xff, 0xff, 0xff, 
  0x08, 0x7f, 0xff, 0xff, 0xfe, 0xff, 0xbf, 0xff, 0xff, 0xfd, 0xff, 0xdf, 0xff, 0xff, 0xfd, 0xff, 
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  0xff, 0xff, 0xfc, 0x7f, 0x1f, 0xff, 0xff, 0xff, 0xc1, 0xff, 0xff, 0xff, 0xff, 0xff, 0xff, 0xff
};

static const unsigned char PROGMEM littleHeart[] =
{ 0x03, 0xC0, 0xF0, 0x06, 0x71, 0x8C, 0x0C, 0x1B, 0x06, 0x18, 0x0E, 0x02, 0x10, 0x0C, 0x03, 0x10,              
0x04, 0x01, 0x10, 0x04, 0x01, 0x10, 0x40, 0x01, 0x10, 0x40, 0x01, 0x10, 0xC0, 0x03, 0x08, 0x88,
0x02, 0x08, 0xB8, 0x04, 0xFF, 0x37, 0x08, 0x01, 0x30, 0x18, 0x01, 0x90, 0x30, 0x00, 0xC0, 0x60,
0x00, 0x60, 0xC0, 0x00, 0x31, 0x80, 0x00, 0x1B, 0x00, 0x00, 0x0E, 0x00, 0x00, 0x04, 0x00,  };


const unsigned char fullHeart [] PROGMEM =
{
  0x00, 0x00, 0x00, 0x00, 0x01, 0x80, 0x18, 0x00, 0x0f, 0xe0, 0x7f, 0x00, 0x3f, 0xf9, 0xff, 0xc0,
  0x7f, 0xf9, 0xff, 0xc0, 0x7f, 0xff, 0xff, 0xe0, 0x7f, 0xff, 0xff, 0xe0, 0xff, 0xff, 0xff, 0xf0,
  0xff, 0xf7, 0xff, 0xf0, 0xff, 0xe7, 0xff, 0xf0, 0xff, 0xe7, 0xff, 0xf0, 0x7f, 0xdb, 0xff, 0xe0,
  0x7f, 0x9b, 0xff, 0xe0, 0x00, 0x3b, 0xc0, 0x00, 0x3f, 0xf9, 0x9f, 0xc0, 0x3f, 0xfd, 0xbf, 0xc0,
  0x1f, 0xfd, 0xbf, 0x80, 0x0f, 0xfd, 0x7f, 0x00, 0x07, 0xfe, 0x7e, 0x00, 0x03, 0xfe, 0xfc, 0x00,
  0x01, 0xff, 0xf8, 0x00, 0x00, 0xff, 0xf0, 0x00, 0x00, 0x7f, 0xe0, 0x00, 0x00, 0x3f, 0xc0, 0x00,
  0x00, 0x0f, 0x00, 0x00, 0x00, 0x06, 0x00, 0x00, 0x00, 0x00, 0x00, 0x00, 0x00, 0x00, 0x00, 0x00
};

static const unsigned char PROGMEM fingerTouch [] = {
0x00, 0x00, 0x00, 0x00, 0xF0, 0x00, 0x03, 0x08, 0x00, 0x06, 0x64, 0x00, 0x05, 0x92, 0x00, 0x09,
0x0A, 0x00, 0x0A, 0xEA, 0x00, 0x0A, 0x9A, 0x00, 0x08, 0x9A, 0x00, 0x04, 0x92, 0x00, 0x06, 0x94,
0x00, 0x02, 0x98, 0x00, 0x00, 0x90, 0x00, 0x00, 0x9C, 0x00, 0x00, 0x97, 0x80, 0x00, 0x96, 0xE0,
0x00, 0x96, 0xD0, 0x04, 0x96, 0x90, 0x0E, 0x80, 0x90, 0x09, 0x80, 0x10, 0x09, 0x80, 0x10, 0x09,
0x80, 0x10, 0x04, 0x80, 0x10, 0x04, 0x00, 0x10, 0x04, 0x00, 0x10, 0x02, 0x00, 0x10, 0x02, 0x00,
0x20, 0x03, 0x00, 0x20, 0x01, 0x80, 0x40, 0x00, 0xE1, 0x80, 0x00, 0x3E, 0x00, 0x00, 0x00, 0x00
};

const unsigned char pressure_img [] PROGMEM = {
  0x00, 0x00, 0x00, 0x00, 0x00, 0x00, 0x00, 0x00, 0x00, 0x00, 0x00, 0x00, 0x00, 0x00, 0x00, 0x00, 
  0x07, 0xf0, 0x7f, 0x00, 0x18, 0x19, 0x81, 0x80, 0x37, 0x07, 0x00, 0x40, 0x2c, 0x02, 0x00, 0x20, 
  0x40, 0x00, 0x0e, 0x30, 0x40, 0x00, 0x35, 0x90, 0x40, 0x00, 0x40, 0x60, 0x40, 0x00, 0x80, 0x20, 
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  0x00, 0x00, 0x00, 0x00
};
void screen_manager_init(){
  
  if(!display.begin(SSD1306_SWITCHCAPVCC))
  {
    Serial.println(F("SSD1306 allocation failed"));
    for(;;);
  }
  
  display.clearDisplay();
  display.display();
  delay(1000);

  display.clearDisplay();
  display.drawBitmap(0, 0, epd_bitmap_RPM, SCREEN_WIDTH, SCREEN_HEIGHT, SSD1306_WHITE);
  display.display();
  delay(5000);

  AllPixels();
  TextDisplay();

  button_a.setDebounceTime(50); // set debounce time to 50 milliseconds
  button_a.setCountMode(COUNT_FALLING);
}


void screen_manager_loop(){

  button_a.loop();

  count = button_a.getCount();
  if (lastCount != count) {
    base_p->screen_idx ++;
    if (base_p->screen_idx == 3) base_p->screen_idx = 0;
    
    if(base_p->screen_idx == DISPLAY_TEMP) {
      drawTemperature();
    }else if(base_p->screen_idx == DISPLAY_SAT){
      if (base_p->params.finger_on){
      drawHeart();
      }else {
        noFinger();
      }
    }else if(base_p->screen_idx == DISPLAY_PREA){
      drawPressure();
    }

    lastCount = count;
  }

}

void drawPressure(){
  display.clearDisplay(); 
                                      
    display.drawBitmap(92, 32, pressure_img, 28, 28, SSD1306_WHITE);       
    display.setTextSize(2);                                   
    display.setTextColor(SSD1306_WHITE); 
    display.setCursor(5,5); // x,y                
    display.println("Pressure");            
    display.setCursor(5,32);              
    display.print("SYS:");             
    display.print(base_p->params.SYS); 
               
    display.setCursor(5,50);               
    display.print("DIA:");             
    display.print(base_p->params.DIA); 
     
    display.display();    
}

void drawHeart(){
  display.clearDisplay(); 
                                      
         
  display.setTextSize(1);                                   
  display.setTextColor(SSD1306_WHITE); 
  display.setCursor(10,5); // x,y                
  display.println("Heart Rate"); 
  display.setTextSize(2);            
  display.setCursor(10,15);              
  display.print(base_p->params.heart_rate); 
  display.setTextSize(1);              
  display.print(" BPM"); 
  
  display.setTextSize(1);                                   
  display.setCursor(10,40);                
  display.println("Blood Oxygen"); 
  display.setTextSize(2);            
  display.setCursor(10,50);               
  display.print(base_p->params.saturation); 
  display.setTextSize(1);             
  display.print(" %SpO2"); 

  if (base_p->params.heart_rate > 0 && base_p->params.saturation > 0) {
    display.drawBitmap(85, 5, fullHeart, 28, 28, SSD1306_WHITE);  
  }else{
    display.drawBitmap(85, 5, littleHeart, 24, 21, SSD1306_WHITE);
  }
   
  display.display();   

}

void noFinger(){
  display.clearDisplay();    
   display.setTextSize(1);                    
   display.setTextColor(WHITE);             
   display.setCursor(10,10);                
   display.println("Please Place Finger"); 
   display.setCursor(25,25);
   display.println("For the Sensor"); 
   display.drawBitmap(50, 35, fingerTouch, 20, 30, 1);       
        
//   display.setCursor(15,55);
//   display.println("Klik START Button");      
   display.display();       
   noTone(3);

}

void drawTemperature(){
  display.clearDisplay();
  
   // display temperature
  display.setTextSize(1);
  display.setTextColor(SSD1306_WHITE);
  display.setCursor(60,10);
  display.println("Temperature ");
  display.setTextSize(2);
  display.setCursor(60,30);
  display.println(base_p->params.temp);

  display.drawBitmap(10, 0, temp_img, 40, 64, SSD1306_WHITE);
  display.display(); 

}

void AllPixels()
{
  int i;
  int j;
  display.clearDisplay();
  for(i=0;i<64;i++)
  {
    for(j=0;j<128;j++)
    {
      display.drawPixel(j, i, SSD1306_WHITE);
      
    }
    display.display();
    delay(30);
  }
  
  for(i=0;i<64;i++)
  {
    for(j=0;j<128;j++)
    {
      display.drawPixel(j, i, SSD1306_BLACK);
      
    }
    display.display();
    delay(30);
  }
  
}

void TextDisplay()
{
  display.clearDisplay();
  display.setTextSize(1);
  display.setTextColor(SSD1306_WHITE);
  display.setCursor(18,18);
  display.println("Health Monitoring");
  display.display();
  display.setCursor(45,30);
  display.println("System");
  display.display();
  delay(3000);
}